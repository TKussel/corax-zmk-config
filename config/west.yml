## config/west.yml
```yaml
manifest:
  remotes:
    - name: zmkfirmware
      url-base: https://github.com/zmkfirmware
    - name: dnlbauer
      url-base: https://github.com/dnlbauer
  projects:
    - name: zmk
      import: app/west.yml
      remote: zmkfirmware
      revision: 4dd95d7840eb3d5a3f59bb29fbf1ab054715ef85 # main, includes nice!view serial VCOM inversion (#3294)
    - name: zmk-keyboards-corax
      remote: dnlbauer
      revision: 5b612b0d867cc73c04a9225bbf29c44a921df296
  self:
    path: config
```
